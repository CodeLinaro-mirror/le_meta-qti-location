## conf/layer.conf
```bitbake
BBFILES += "${LAYERDIR}/recipes/*/*.bb ${LAYERDIR}/recipes/*/*.bbappend ${LAYERDIR}/recipes-*/*/*.bb"
BBPATH .= ":${LAYERDIR}"
BBFILE_COLLECTIONS += "qti-location"
BBFILE_PRIORITY_qti-location = "12"
BBFILE_PATTERN_qti-location := "^${LAYERDIR}/"

LAYERVERSION_qti-location = "1"
LAYERSERIES_COMPAT_qti-location = "kirkstone scarthgap"

LAYERDEPENDS_qti-location = " \
    qti-bsp \
    qti-core \
    qti-sepolicy \
"
LAYERDEPENDS_qti-location += "${@oe.utils.conditional('DISTRO', 'auto', 'auto-sepolicy', '', d)}"
LAYERDEPENDS_qti-location += "${@bb.utils.contains('MACHINE_FEATURES', 'qti-data-modem', 'msm-data', '', d)}"
LAYERRECOMMENDS_qti-location = " \
    qti-location-prop \
    qti-location-internal \
"
```
